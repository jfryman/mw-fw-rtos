## sdkconfig.defaults
```kconfig
CONFIG_BOOTLOADER_LOG_LEVEL_NONE=y
CONFIG_ESPTOOLPY_FLASHSIZE_4MB=y
CONFIG_PARTITION_TABLE_CUSTOM=y
CONFIG_ESP_HTTPS_OTA_ALLOW_HTTP=y
CONFIG_ESP_DEFAULT_CPU_FREQ_MHZ_80=y
# CONFIG_ESP_WIFI_NVS_ENABLED is not set
# CONFIG_ESP_WIFI_SOFTAP_SUPPORT is not set
# CONFIG_LWIP_IPV6 is not set
CONFIG_MBEDTLS_TLS_CLIENT_ONLY=y
```
